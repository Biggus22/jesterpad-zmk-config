## config/dts/bindings/behaviors/zmk,behavior-bt-hold.yaml
```yaml
# Copyright (c) 2026
# SPDX-License-Identifier: MIT

description: Behavior that runs a Bluetooth action after being held for a set duration

compatible: "zmk,behavior-bt-hold"

properties:
  "#binding-cells":
    type: int
    required: true
    const: 0
  hold-ms:
    type: int
    required: false
    default: 5000
  profile:
    type: int
    required: false
    default: 0
```

## config/dts/bindings/behaviors/zmk,behavior-rgb-cycle.yaml
```yaml
# Copyright (c) 2026
# SPDX-License-Identifier: MIT

description: Behavior that cycles RGB underglow parameters with rollover

compatible: "zmk,behavior-rgb-cycle"

properties:
  "#binding-cells":
    type: int
    required: true
    const: 0
  mode:
    type: string
    required: true
    enum:
      - brightness
      - speed
```

## config/dts/bindings/behaviors/zmk,behavior-rgb-preset.yaml
```yaml
# Copyright (c) 2026
# SPDX-License-Identifier: MIT

description: Behavior that applies a fixed RGB underglow preset (effect, color, speed)

compatible: "zmk,behavior-rgb-preset"

properties:
  "#binding-cells":
    type: int
    required: true
    const: 0

  h:
    type: int
    required: false
    default: 0

  s:
    type: int
    required: false
    default: 100

  b:
    type: int
    required: false
    default: 100

  effect:
    type: int
    required: false
    default: 0

  speed:
    type: int
    required: false
    default: 3
```

## config/west.yml
```yaml
manifest:
  remotes:
    - name: zmkfirmware
      url-base: https://github.com/zmkfirmware
    - name: biggus22
      url-base: https://github.com/Biggus22
  projects:
    - name: zmk
      remote: zmkfirmware
      revision: af7dcb1e5a261a632277a86d681e1a9ed6ffcf06
      import: app/west.yml
    - name: Jesterpad
      remote: biggus22
      revision: feature/rgb-underglow
  self:
    path: config
```
